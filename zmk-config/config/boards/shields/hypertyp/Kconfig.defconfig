## zmk-config/config/boards/shields/hypertyp/Kconfig.defconfig
```kconfig
if SHIELD_HYPERTYP_LEFT

config ZMK_KEYBOARD_NAME
    default "Hypertyp"

config ZMK_SPLIT_ROLE_CENTRAL
    default y

endif

if SHIELD_HYPERTYP_LEFT || SHIELD_HYPERTYP_RIGHT

config ZMK_SPLIT
    default y

endif
```

## zmk-config/config/boards/shields/hypertyp/Kconfig.shield
```kconfig
config SHIELD_HYPERTYP_LEFT
    def_bool $(shields_list_contains,hypertyp_left)

config SHIELD_HYPERTYP_RIGHT
    def_bool $(shields_list_contains,hypertyp_right)
```
